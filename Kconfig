## Kconfig
```kconfig
config ZMK_INPUT_PROCESSOR_ROTATE
    bool "Rotation input processor for trackball axis correction"
    default y
    depends on ZMK_POINTING

config ZMK_BEHAVIOR_ROTATE_ADJUST
    bool "Behavior to adjust rotation angle at runtime"
    default y
    depends on ZMK_INPUT_PROCESSOR_ROTATE
```

## dts/bindings/zmk,behavior-rotate-adjust.yaml
```yaml
description: |
  Behavior to adjust the rotation angle of an input-processor-rotate
  at runtime. Use step property to set the increment (positive) or
  decrement (negative) in degrees.

compatible: "zmk,behavior-rotate-adjust"

include: [zero_param.yaml]

properties:
  processor:
    type: phandle
    required: true
    description: Reference to the input-processor-rotate device to adjust
  step:
    type: int
    required: true
    description: Angle adjustment step in degrees (e.g. 1 or -1)
```

## dts/bindings/zmk,input-processor-rotate.yaml
```yaml
description: |
  Skew compensation input processor for trackball sensors.
  Corrects Y-to-X axis crosstalk by subtracting a fraction of Y from X.

compatible: "zmk,input-processor-rotate"

include: [base.yaml]

properties:
  "#input-processor-cells":
    type: int
    required: true
    const: 0
  type:
    type: int
    required: true
  x-code:
    type: int
    required: true
  y-code:
    type: int
    required: true
  skew-percent:
    type: int
    required: true
    description: Compensation factor as percentage (e.g. 28 = subtract 28% of Y from X)
  track-remainders:
    type: boolean
```
